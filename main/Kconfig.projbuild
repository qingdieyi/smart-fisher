## main/Kconfig.projbuild
```kconfig
# ═══════════════════════════════════════════════════════════════════
# 项目配置菜单 — Kconfig.projbuild
#
# ── 这是什么？ ───────────────────────────────────────────────────
#
# Kconfig 是 Linux 内核使用的配置系统，ESP-IDF 继承了它。
# 这个文件定义了运行 `idf.py menuconfig` 时看到的配置界面。
#
# ── 给 Java 开发者 ───────────────────────────────────────────────
#
#   Java 概念                       Kconfig 对应
#   ──────────────────────────────────────────────────────────────
#   application.yml 中的配置项       Kconfig 中的 config 项
#   配置项的类型（String/int/bool）  Kconfig 的 string/int/bool 关键字
#   @ConfigurationProperties        menuconfig 界面的菜单
#   配置项的 default 值              default 关键字
#   IDE 的配置提示                   help 块
#
# ── 怎么用 ───────────────────────────────────────────────────────
#
#   1. 运行 `idf.py menuconfig`
#   2. 进入 "Smart Fisher Configuration" 菜单
#   3. 修改 SSID、密码、检测方式等
#   4. 保存退出 → 自动生成 sdkconfig 文件
#
#   注意：sdkconfig 是运行时生成的，不要手动编辑。
#   如果要设默认值，改 sdkconfig.defaults 文件。
#
# ═══════════════════════════════════════════════════════════════════

menu "Smart Fisher Configuration"
    # menu = 创建一个菜单子项（类似配置页面的一个 tab）

    # ── WiFi 配置 ──────────────────────────────────────────────

    config SMART_FISHER_WIFI_SSID
        string "WiFi SSID"
        # config 定义一个配置项
        # string = 值的类型是字符串
        # "WiFi SSID" = 在菜单中显示的标签
        default "yang"
        # default = 默认值（当 sdkconfig 中还没有这个配置项时使用）
        help
            SSID (network name) for the Smart Fisher to connect to.

    config SMART_FISHER_WIFI_PASSWORD
        string "WiFi Password"
        default "yang123456"
        help
            WiFi password (WPA2-PSK).

    # ── 鱼群检测方式选择 ──────────────────────────────────────

    choice SMART_FISHER_DETECTION_METHOD
        prompt "Fish Detection Method"
        default SMART_FISHER_DETECTION_FRAME_DIFF
        help
            Select the algorithm used to detect fish in the aquarium.

            Frame Differencing:
              - Fast (~80ms), low memory (~40KB)
              - Detects movement only (can miss stationary fish)
              - No external dependencies or model files needed
              - Good for: getting started, resource-constrained setups

            YOLO Object Detection (ESP-DL):
              - Neural network-based, can detect fish even when stationary
              - Memory: ~700KB PSRAM, ~500KB Flash (model weights)
              - Requires: trained .espdl model file placed in main/models/
              - Good for: accurate counting, species identification

        config SMART_FISHER_DETECTION_FRAME_DIFF
            bool "Frame Differencing (motion-based)"
            help
                Simple motion detection using pixel comparison between
                consecutive frames. Detects movement regions and estimates
                fish count via connected-component analysis.

                Pros: Zero dependencies, fast, low memory.
                Cons: Cannot detect stationary fish; bubbles/water flow
                      may cause false positives.

        config SMART_FISHER_DETECTION_YOLO
            bool "YOLO Object Detection (ESP-DL neural network)"
            help
                Deep learning based fish detection using YOLO architecture
                running on ESP-DL inference engine.

                Prerequisites:
                  1. Trained .espdl model file placed at:
                     main/models/espdet_pico_fish.espdl
                  2. ESP-DL component added to idf_component.yml:
                     espressif/esp-dl: "^3.3.0"

                Training guide: docs/yolo-practical-guide.md
                Architecture plan: docs/esp-dl-yolo-plan.md
    endchoice

    # ── YOLO 相关配置（仅在选择 YOLO 时可见） ──────────────────

    config SMART_FISHER_YOLO_MODEL_PATH
        string "YOLO Model File Path"
        depends on SMART_FISHER_DETECTION_YOLO
        default "main/models/espdet_pico_fish.espdl"
        help
            Path to the .espdl model file, relative to the project root.
            This file is generated by the esp-detection training pipeline.

    config SMART_FISHER_YOLO_CONFIDENCE_THRESHOLD
        float "YOLO Confidence Threshold"
        depends on SMART_FISHER_DETECTION_YOLO
        default 0.50
        range 0.10 0.95
        help
            Minimum confidence score for a detection to be considered valid.
            Lower values = more detections (may include false positives).
            Higher values = fewer detections (may miss real fish).
            Recommended: 0.40 ~ 0.60

    config SMART_FISHER_YOLO_IOU_THRESHOLD
        float "YOLO NMS IoU Threshold"
        depends on SMART_FISHER_DETECTION_YOLO
        default 0.45
        range 0.20 0.80
        help
            Intersection-over-Union threshold for Non-Maximum Suppression.
            Controls how much overlap is allowed between detected boxes.
            Lower values = more aggressive merging.
            Recommended: 0.40 ~ 0.50

endmenu
```

## sdkconfig.defaults
```kconfig
# ═══════════════════════════════════════════════════════════════════
# SDK 配置默认值 — sdkconfig.defaults
#
# ── 这是什么？ ───────────────────────────────────────────────────
#
# 这个文件为 Kconfig 配置项提供"出厂默认值"。
#
# sdkconfig 的三个层次：
#
#   1. Kconfig 文件（项目 + ESP-IDF）
#      → 定义了哪些配置项存在、它们的类型和默认值
#
#   2. sdkconfig.defaults（就是这个文件）
#      → 覆盖 Kconfig 中 hardcoded 的 default 值
#      → 提交到 git，团队成员共享
#
#   3. sdkconfig（自动生成，不提交 git）
#      → 运行 menuconfig 后生成的最终配置
#      → 包含你个人修改的值
#
# ── Java 类比 ─────────────────────────────────────────────────────
#
#   层次                         Java 对应
#   ────────────────────────────────────────────────────────────────
#   Kconfig (ESP-IDF 默认)      库的默认配置（如 Spring Boot 的默认值）
#   sdkconfig.defaults           application.yml（项目级别默认值）
#   sdkconfig                    application-dev.yml（个人覆盖，不进 git）
#
# ═══════════════════════════════════════════════════════════════════

# ── WiFi 配置 ─────────────────────────────────────────────────────

# WiFi 网络名称（SSID）
CONFIG_SMART_FISHER_WIFI_SSID="yang"

# WiFi 密码
CONFIG_SMART_FISHER_WIFI_PASSWORD="yang123456"

# ── PSRAM 配置（摄像头必须！） ────────────────────────────────────
#
# ESP32-S3-CAM R16N8 有 8MB Octal PSRAM
# R16N8 = R(PSRAM) + 16(16MB Flash) + N(Octal) + 8(8MB PSRAM)
#
# 摄像头帧缓冲必须放在 PSRAM 中 —— 内部 SRAM 只有 512KB 不够用
# 如果不开启 PSRAM，esp_camera_init() 会返回 ESP_ERR_NO_MEM

# 启用 PSRAM（SPIRAM = SPI PSRAM）
CONFIG_SPIRAM=y

# PSRAM 模式：Octal SPI（ESP32-S3 支持，比 Quad 快一倍）
CONFIG_SPIRAM_MODE_OCT=y

# PSRAM 速度：80MHz（和参考程序一致）
CONFIG_SPIRAM_SPEED_80M=y

# 将 PSRAM 加入 malloc 分配池
CONFIG_SPIRAM_USE_MALLOC=y

# 不允许 BSS 段放 PSRAM（和参考程序一致，避免初始化顺序问题）
# CONFIG_SPIRAM_ALLOW_BSS_SEG_EXTERNAL_MEMORY is not set

# SCCB (I²C) 时钟频率 — 最低 100kHz，提高稳定性
CONFIG_SCCB_CLK_FREQ=100000

# ── 鱼群检测方式 ──────────────────────────────────────────────────
#
# 默认使用帧差法（不需要模型文件，不需要 ESP-DL）
# 切换到 YOLO 的步骤:
#   1. 训练模型: 参照 docs/yolo-practical-guide.md
#   2. 放置模型: main/models/espdet_pico_fish.espdl
#   3. 启用: idf.py menuconfig → Smart Fisher Configuration
#           → Fish Detection Method → YOLO Object Detection
#   4. 添加依赖: idf_component.yml 中取消 espressif/esp-dl 的注释
#   5. 重新编译: idf.py fullclean && idf.py build

# 帧差法 — 不需要外部依赖，默认启用
CONFIG_SMART_FISHER_DETECTION_FRAME_DIFF=y

# YOLO — 取消下面注释来启用（需要完成上述准备步骤）
# CONFIG_SMART_FISHER_DETECTION_YOLO=y
# CONFIG_SMART_FISHER_YOLO_MODEL_PATH="main/models/espdet_pico_fish.espdl"
# CONFIG_SMART_FISHER_YOLO_CONFIDENCE_THRESHOLD=0.50
# CONFIG_SMART_FISHER_YOLO_IOU_THRESHOLD=0.45

# ── MQTT 配置 ──────────────────────────────────────────────────────

# MQTT Broker 地址（公共测试 Broker，免费无需注册）
# 取消注释以覆盖默认值:
# CONFIG_BROKER_URI="mqtt://broker.emqx.io:1883"

# ── 其他 ──────────────────────────────────────────────────────────

# 开启 Task Watchdog（任务看门狗 — 如果任务卡死超 10 秒，自动重启）
# CONFIG_ESP_TASK_WDT=y
# CONFIG_ESP_TASK_WDT_TIMEOUT_S=10
```
